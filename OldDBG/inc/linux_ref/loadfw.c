NTSTATUS BcSdmaLoadFirmware(const ULONG *Dwords, ULONG Count, ULONG *OutVersion, ULONG *OutChecksum)
{
    ULONG i, f32_cntl;

    if (g_Dev.Mmio == NULL) {
        return STATUS_DEVICE_NOT_READY;
    }
    if (g_Dev.ArmLevel < BC250DBG_ARM_WRITE) {
        return STATUS_ACCESS_DENIED;
    }
    if (Dwords == NULL || Count == 0) {
        return STATUS_INVALID_PARAMETER;
    }

    /* Halt the F32 microcontroller */
    f32_cntl = BcRegReadRaw(A_SDMA0_F32_CNTL);
    BcRegWriteRaw(A_SDMA0_F32_CNTL, f32_cntl | 1);

    /* Reset UCODE address pointer */
    BcRegWriteRaw(A_SDMA0_UCODE_ADDR, 0);

    /* Stream dwords into instruction RAM */
    for (i = 0; i < Count; i++) {
        BcRegWriteRaw(A_SDMA0_UCODE_DATA, Dwords[i]);
    }

    if (OutChecksum) *OutChecksum = BcRegReadRaw(A_SDMA0_UCODE_CHECKSUM);
    if (OutVersion)  *OutVersion  = BcRegReadRaw(A_SDMA0_UCODE_ADDR);

    /* Unhalt the F32 microcontroller */
    f32_cntl = BcRegReadRaw(A_SDMA0_F32_CNTL);
    BcRegWriteRaw(A_SDMA0_F32_CNTL, f32_cntl & ~1UL);

    BcLogText(BC250DBG_LVL_INFO, BC250DBG_SUB_SDMA,
              "SDMA0 Firmware carregado: %u dwords (%u B), checksum=0x%08X",
              Count, Count * 4, OutChecksum ? *OutChecksum : 0);

    return STATUS_SUCCESS;
}
